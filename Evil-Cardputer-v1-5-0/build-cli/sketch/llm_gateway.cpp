#line 1 "C:\\Coding\\CardputerADV-E2C\\Evil-Cardputer-v1-5-0\\llm_gateway.cpp"
/*
 * llm_gateway.cpp - LLM Gateway Client for Evil-Cardputer
 *
 * Secure client for TUI LLM Gateway with ECDSA authentication.
 *
 * Auth flow:
 * 1. Client sends public key, server returns challenge+nonce+signature
 * 2. Client verifies server signature, signs challenge
 * 3. Server verifies, returns session token
 * 4. Client uses Bearer token for all API calls
 */

#include "llm_gateway.h"
#include <M5Cardputer.h>
#include "gui/gui.h"

using LB = GUI::LegacyBridge;
#include <WiFiClient.h>
#include <SD.h>
#include <ArduinoJson.h>
#include <vector>

// MbedTLS for ECDSA
#include "mbedtls/ecdsa.h"
#include "mbedtls/ecp.h"
#include "mbedtls/sha256.h"
#include "mbedtls/entropy.h"
#include "mbedtls/ctr_drbg.h"
#include "mbedtls/bignum.h"
#include "mbedtls/private_access.h"
#include "mbedtls/platform_util.h"

// ============================================================================
// Configuration
// ============================================================================

static LLMGWConfig llmGWConfig = {
    "",                             // serverHost
    LLM_GW_DEFAULT_PORT,            // serverPort
    "",                             // selectedModel
    true,                           // autoReconnect
};

// ============================================================================
// Static Keys
// ============================================================================

static struct {
    bool loaded;
    uint8_t privateKey[LLM_GW_ECDSA_PRIVKEY_SIZE];
    uint8_t publicKey[LLM_GW_ECDSA_PUBKEY_SIZE];
    uint8_t serverPublicKey[LLM_GW_ECDSA_PUBKEY_SIZE];
    mbedtls_ecp_keypair ecdsaKey;
    mbedtls_ecp_point serverPubPoint;
} llmGWKeys;

// ============================================================================
// Session State
// ============================================================================

static struct {
    LLMGWState state;
    WiFiClient client;
    mbedtls_entropy_context entropy;
    mbedtls_ctr_drbg_context ctr_drbg;
    char sessionToken[64];
    uint64_t tokenExpiresAt;
    char chatSessionId[64];
    char currentModel[64];
    std::vector<String> models;
} llmGWSession;

// ============================================================================
// Forward declarations
// ============================================================================

static LLMGWError llmGWConnect();
static LLMGWError llmGWAuthenticate();
static LLMGWError llmGWFetchModels();
static LLMGWError llmGWStartChat(const char* model);
static LLMGWError llmGWSendMessage(const char* message, String& response);
static LLMGWError llmGWStopChat();
static void llmGWDisconnect();
static bool llmGWSign(const uint8_t* data, size_t dataLen, uint8_t* signature);
static bool llmGWVerifyServerSig(const uint8_t* data, size_t dataLen, const uint8_t* sig);
static String llmGWHttpRequest(const char* method, const char* path, const String& body, int& httpCode);
static void llmGWDrawStatus(const char* line1, const char* line2 = nullptr);
static void llmGWShowError(LLMGWError err);
static void llmGWChatLoop();
static int llmGWSelectModel();
static void bytesToHex(const uint8_t* bytes, size_t len, char* hex);
static bool hexToBytes(const char* hex, uint8_t* bytes, size_t maxLen);

// ============================================================================
// Configuration Load/Save
// ============================================================================

void llmGWLoadConfig() {
    if (!SD.exists(LLM_GW_CONFIG_PATH)) return;

    File f = SD.open(LLM_GW_CONFIG_PATH, FILE_READ);
    if (!f) return;

    StaticJsonDocument<256> doc;
    if (deserializeJson(doc, f) == DeserializationError::Ok) {
        strlcpy(llmGWConfig.serverHost, doc["host"] | "", sizeof(llmGWConfig.serverHost));
        llmGWConfig.serverPort = doc["port"] | LLM_GW_DEFAULT_PORT;
        strlcpy(llmGWConfig.selectedModel, doc["model"] | "", sizeof(llmGWConfig.selectedModel));
        llmGWConfig.autoReconnect = doc["autoReconnect"] | true;
    }
    f.close();
}

void llmGWSaveConfig() {
    File f = SD.open(LLM_GW_CONFIG_PATH, FILE_WRITE);
    if (!f) return;

    StaticJsonDocument<256> doc;
    doc["host"] = llmGWConfig.serverHost;
    doc["port"] = llmGWConfig.serverPort;
    doc["model"] = llmGWConfig.selectedModel;
    doc["autoReconnect"] = llmGWConfig.autoReconnect;

    serializeJson(doc, f);
    f.close();
}

// ============================================================================
// Key Management
// ============================================================================

bool llmGWKeysExist() {
    return SD.exists(LLM_GW_PRIVKEY_PATH) && SD.exists(LLM_GW_PUBKEY_PATH);
}

// Key generation removed - LLM Gateway uses same keys as Remote Desktop
// Keys are generated by RDP and stored in /rd_keys/

bool llmGWLoadKeys() {
    if (llmGWKeys.loaded) return true;

    mbedtls_ecp_keypair_init(&llmGWKeys.ecdsaKey);
    mbedtls_ecp_point_init(&llmGWKeys.serverPubPoint);

    // Load private key
    File f = SD.open(LLM_GW_PRIVKEY_PATH, FILE_READ);
    if (!f || f.size() != LLM_GW_ECDSA_PRIVKEY_SIZE) {
        Serial.println("[LLMGW] Failed to read private key");
        if (f) f.close();
        return false;
    }
    f.read(llmGWKeys.privateKey, LLM_GW_ECDSA_PRIVKEY_SIZE);
    f.close();

    // Load public key
    f = SD.open(LLM_GW_PUBKEY_PATH, FILE_READ);
    if (!f || f.size() != LLM_GW_ECDSA_PUBKEY_SIZE) {
        Serial.println("[LLMGW] Failed to read public key");
        if (f) f.close();
        return false;
    }
    f.read(llmGWKeys.publicKey, LLM_GW_ECDSA_PUBKEY_SIZE);
    f.close();

    // Load server public key if exists (65 bytes uncompressed, same as RDP)
    if (SD.exists(LLM_GW_SERVER_PUBKEY_PATH)) {
        f = SD.open(LLM_GW_SERVER_PUBKEY_PATH, FILE_READ);
        if (f && f.size() == LLM_GW_ECDSA_PUBKEY_SIZE) {
            f.read(llmGWKeys.serverPublicKey, LLM_GW_ECDSA_PUBKEY_SIZE);
            f.close();
            Serial.println("[LLMGW] Server public key loaded from file");
        } else {
            if (f) f.close();
            Serial.println("[LLMGW] Server public key not found or wrong size");
        }
    }

    // Setup ECDSA keypair
    int ret = mbedtls_ecp_group_load(&llmGWKeys.ecdsaKey.MBEDTLS_PRIVATE(grp), MBEDTLS_ECP_DP_SECP256R1);
    if (ret != 0) {
        Serial.printf("[LLMGW] ECP group load failed: -0x%04X\n", -ret);
        return false;
    }

    ret = mbedtls_mpi_read_binary(&llmGWKeys.ecdsaKey.MBEDTLS_PRIVATE(d),
                                   llmGWKeys.privateKey, LLM_GW_ECDSA_PRIVKEY_SIZE);
    if (ret != 0) {
        Serial.printf("[LLMGW] Import private key failed: -0x%04X\n", -ret);
        return false;
    }

    ret = mbedtls_ecp_point_read_binary(&llmGWKeys.ecdsaKey.MBEDTLS_PRIVATE(grp),
                                         &llmGWKeys.ecdsaKey.MBEDTLS_PRIVATE(Q),
                                         llmGWKeys.publicKey, LLM_GW_ECDSA_PUBKEY_SIZE);
    if (ret != 0) {
        Serial.printf("[LLMGW] Import public key failed: -0x%04X\n", -ret);
        return false;
    }

    ret = mbedtls_ecp_check_pub_priv(&llmGWKeys.ecdsaKey, &llmGWKeys.ecdsaKey,
                                     mbedtls_ctr_drbg_random, &llmGWSession.ctr_drbg);
    if (ret != 0) {
        Serial.printf("[LLMGW] Keypair validation failed: -0x%04X\n", -ret);
        return false;
    }

    llmGWKeys.loaded = true;
    Serial.println("[LLMGW] Keys loaded successfully");
    return true;
}

// ============================================================================
// ECDSA Signing
// ============================================================================

static bool llmGWSign(const uint8_t* data, size_t dataLen, uint8_t* signature) {
    if (!llmGWKeys.loaded) return false;

    // Hash the data (ECDSA signs SHA256 hash)
    uint8_t hash[32];
    mbedtls_sha256(data, dataLen, hash, 0);

    mbedtls_mpi r, s;
    mbedtls_mpi_init(&r);
    mbedtls_mpi_init(&s);

    int ret = mbedtls_ecdsa_sign(&llmGWKeys.ecdsaKey.MBEDTLS_PRIVATE(grp), &r, &s,
                                  &llmGWKeys.ecdsaKey.MBEDTLS_PRIVATE(d),
                                  hash, sizeof(hash),
                                  mbedtls_ctr_drbg_random, &llmGWSession.ctr_drbg);
    if (ret != 0) {
        Serial.printf("[LLMGW] ECDSA sign failed: -0x%04X\n", -ret);
        mbedtls_mpi_free(&r);
        mbedtls_mpi_free(&s);
        return false;
    }

    // Export r || s (32 + 32 bytes)
    ret = mbedtls_mpi_write_binary(&r, signature, 32);
    if (ret != 0) {
        mbedtls_mpi_free(&r);
        mbedtls_mpi_free(&s);
        return false;
    }

    ret = mbedtls_mpi_write_binary(&s, signature + 32, 32);
    mbedtls_mpi_free(&r);
    mbedtls_mpi_free(&s);

    return ret == 0;
}

// ============================================================================
// Hex conversion utilities
// ============================================================================

static void bytesToHex(const uint8_t* bytes, size_t len, char* hex) {
    for (size_t i = 0; i < len; i++) {
        sprintf(hex + (i * 2), "%02x", bytes[i]);
    }
    hex[len * 2] = '\0';
}

static bool hexToBytes(const char* hex, uint8_t* bytes, size_t maxLen) {
    size_t hexLen = strlen(hex);
    if (hexLen % 2 != 0 || hexLen / 2 > maxLen) return false;

    for (size_t i = 0; i < hexLen; i += 2) {
        char byteStr[3] = { hex[i], hex[i + 1], '\0' };
        bytes[i / 2] = (uint8_t)strtol(byteStr, nullptr, 16);
    }
    return true;
}

// ============================================================================
// HTTP Client
// ============================================================================

static String llmGWHttpRequest(const char* method, const char* path, const String& body, int& httpCode) {
    httpCode = 0;

    if (!llmGWSession.client.connect(llmGWConfig.serverHost, llmGWConfig.serverPort)) {
        Serial.println("[LLMGW] Connection failed");
        return "";
    }

    // Build request
    String request = String(method) + " " + path + " HTTP/1.1\r\n";
    request += "Host: " + String(llmGWConfig.serverHost) + "\r\n";
    request += "Content-Type: application/json\r\n";

    // Add auth header if we have a token
    if (strlen(llmGWSession.sessionToken) > 0) {
        request += "Authorization: Bearer " + String(llmGWSession.sessionToken) + "\r\n";
    }

    if (body.length() > 0) {
        request += "Content-Length: " + String(body.length()) + "\r\n";
    }
    request += "Connection: close\r\n\r\n";

    if (body.length() > 0) {
        request += body;
    }

    llmGWSession.client.print(request);
    llmGWSession.client.setTimeout(LLM_GW_HTTP_TIMEOUT_MS);

    // Read response status line
    String statusLine = llmGWSession.client.readStringUntil('\n');
    if (statusLine.startsWith("HTTP/1.")) {
        int spacePos = statusLine.indexOf(' ');
        if (spacePos > 0) {
            httpCode = statusLine.substring(spacePos + 1, spacePos + 4).toInt();
        }
    }

    // Skip headers
    while (llmGWSession.client.connected()) {
        String line = llmGWSession.client.readStringUntil('\n');
        if (line == "\r" || line.length() == 0) break;
    }

    // Read body
    String responseBody = "";
    while (llmGWSession.client.available()) {
        responseBody += llmGWSession.client.readString();
    }

    llmGWSession.client.stop();

    return responseBody;
}

// ============================================================================
// Authentication
// ============================================================================

static LLMGWError llmGWAuthenticate() {
    llmGWSession.state = LLM_GW_STATE_AUTHENTICATING;
    llmGWDrawStatus("Authenticating...");

    // Step 1: Get challenge
    char pubKeyHex[LLM_GW_ECDSA_PUBKEY_SIZE * 2 + 1];
    bytesToHex(llmGWKeys.publicKey, LLM_GW_ECDSA_PUBKEY_SIZE, pubKeyHex);

    StaticJsonDocument<256> challengeReq;
    challengeReq["client_public_key"] = pubKeyHex;
    String reqBody;
    serializeJson(challengeReq, reqBody);

    int httpCode;
    String response = llmGWHttpRequest("POST", "/auth/challenge", reqBody, httpCode);

    if (httpCode != 200) {
        Serial.printf("[LLMGW] Challenge failed: HTTP %d\n", httpCode);
        return LLM_GW_ERR_AUTH_FAILED;
    }

    StaticJsonDocument<512> challengeResp;
    if (deserializeJson(challengeResp, response) != DeserializationError::Ok) {
        Serial.println("[LLMGW] Failed to parse challenge response");
        return LLM_GW_ERR_PARSE_ERROR;
    }

    const char* challengeHex = challengeResp["challenge"];
    uint64_t timestamp = challengeResp["timestamp"];
    const char* nonceHex = challengeResp["nonce"];
    const char* serverSigHex = challengeResp["server_signature"];

    if (!challengeHex || !nonceHex || !serverSigHex) {
        Serial.println("[LLMGW] Missing fields in challenge response");
        return LLM_GW_ERR_PARSE_ERROR;
    }

    // Decode challenge
    uint8_t challenge[LLM_GW_CHALLENGE_SIZE];
    if (!hexToBytes(challengeHex, challenge, sizeof(challenge))) {
        return LLM_GW_ERR_PARSE_ERROR;
    }

    // Step 2: Sign the challenge hash
    uint8_t clientSig[LLM_GW_ECDSA_SIG_SIZE];
    if (!llmGWSign(challenge, LLM_GW_CHALLENGE_SIZE, clientSig)) {
        return LLM_GW_ERR_SIGNATURE_FAILED;
    }

    char clientSigHex[LLM_GW_ECDSA_SIG_SIZE * 2 + 1];
    bytesToHex(clientSig, LLM_GW_ECDSA_SIG_SIZE, clientSigHex);

    // Step 3: Verify signature
    StaticJsonDocument<256> verifyReq;
    verifyReq["nonce"] = nonceHex;
    verifyReq["client_signature"] = clientSigHex;
    String verifyBody;
    serializeJson(verifyReq, verifyBody);

    response = llmGWHttpRequest("POST", "/auth/verify", verifyBody, httpCode);

    if (httpCode != 200) {
        Serial.printf("[LLMGW] Verify failed: HTTP %d\n", httpCode);
        return LLM_GW_ERR_AUTH_FAILED;
    }

    StaticJsonDocument<256> verifyResp;
    if (deserializeJson(verifyResp, response) != DeserializationError::Ok) {
        return LLM_GW_ERR_PARSE_ERROR;
    }

    const char* token = verifyResp["session_token"];
    uint64_t expiresAt = verifyResp["expires_at"];

    if (!token) {
        return LLM_GW_ERR_AUTH_FAILED;
    }

    strlcpy(llmGWSession.sessionToken, token, sizeof(llmGWSession.sessionToken));
    llmGWSession.tokenExpiresAt = expiresAt;
    llmGWSession.state = LLM_GW_STATE_READY;

    Serial.printf("[LLMGW] Authenticated, token expires at %llu\n", expiresAt);
    return LLM_GW_OK;
}

// ============================================================================
// Model Management
// ============================================================================

static LLMGWError llmGWFetchModels() {
    llmGWDrawStatus("Fetching models...");

    int httpCode;
    String response = llmGWHttpRequest("GET", "/models?type=local", "", httpCode);

    if (httpCode == 401) {
        return LLM_GW_ERR_SESSION_EXPIRED;
    }

    if (httpCode != 200) {
        Serial.printf("[LLMGW] Fetch models failed: HTTP %d\n", httpCode);
        return LLM_GW_ERR_HTTP_ERROR;
    }

    StaticJsonDocument<2048> doc;
    if (deserializeJson(doc, response) != DeserializationError::Ok) {
        return LLM_GW_ERR_PARSE_ERROR;
    }

    llmGWSession.models.clear();
    JsonArray models = doc["models"].as<JsonArray>();
    for (JsonObject model : models) {
        const char* name = model["name"];
        if (name) {
            llmGWSession.models.push_back(String(name));
        }
    }

    Serial.printf("[LLMGW] Found %d models\n", llmGWSession.models.size());
    return LLM_GW_OK;
}

// ============================================================================
// Chat Session Management
// ============================================================================

static LLMGWError llmGWStartChat(const char* model) {
    llmGWDrawStatus("Starting chat...", model);

    StaticJsonDocument<128> req;
    req["model"] = model;
    String body;
    serializeJson(req, body);

    int httpCode;
    String response = llmGWHttpRequest("POST", "/chat/start", body, httpCode);

    if (httpCode == 401) {
        return LLM_GW_ERR_SESSION_EXPIRED;
    }

    if (httpCode != 200) {
        Serial.printf("[LLMGW] Start chat failed: HTTP %d\n", httpCode);
        return LLM_GW_ERR_CHAT_FAILED;
    }

    StaticJsonDocument<256> doc;
    if (deserializeJson(doc, response) != DeserializationError::Ok) {
        return LLM_GW_ERR_PARSE_ERROR;
    }

    const char* sessionId = doc["session_id"];
    if (!sessionId) {
        return LLM_GW_ERR_CHAT_FAILED;
    }

    strlcpy(llmGWSession.chatSessionId, sessionId, sizeof(llmGWSession.chatSessionId));
    strlcpy(llmGWSession.currentModel, model, sizeof(llmGWSession.currentModel));
    llmGWSession.state = LLM_GW_STATE_CHATTING;

    Serial.printf("[LLMGW] Chat started: %s\n", sessionId);
    return LLM_GW_OK;
}

static LLMGWError llmGWSendMessage(const char* message, String& response) {
    StaticJsonDocument<4096> req;
    req["session_id"] = llmGWSession.chatSessionId;
    req["message"] = message;
    String body;
    serializeJson(req, body);

    // Use longer timeout for LLM response
    llmGWSession.client.setTimeout(LLM_GW_CHAT_TIMEOUT_MS);

    int httpCode;
    String resp = llmGWHttpRequest("POST", "/chat/send", body, httpCode);

    if (httpCode == 401) {
        return LLM_GW_ERR_SESSION_EXPIRED;
    }

    if (httpCode != 200) {
        Serial.printf("[LLMGW] Send message failed: HTTP %d\n", httpCode);
        return LLM_GW_ERR_CHAT_FAILED;
    }

    StaticJsonDocument<8192> doc;
    if (deserializeJson(doc, resp) != DeserializationError::Ok) {
        return LLM_GW_ERR_PARSE_ERROR;
    }

    const char* respText = doc["response"];
    if (respText) {
        response = String(respText);
    } else {
        response = "";
    }

    return LLM_GW_OK;
}

static LLMGWError llmGWStopChat() {
    if (strlen(llmGWSession.chatSessionId) == 0) {
        return LLM_GW_OK;
    }

    StaticJsonDocument<128> req;
    req["session_id"] = llmGWSession.chatSessionId;
    String body;
    serializeJson(req, body);

    int httpCode;
    llmGWHttpRequest("POST", "/chat/stop", body, httpCode);

    llmGWSession.chatSessionId[0] = '\0';
    llmGWSession.state = LLM_GW_STATE_READY;

    return LLM_GW_OK;
}

// ============================================================================
// UI Helpers
// ============================================================================

// Simple input prompt screen (clear + label + cursor)
static void llmGWPromptScreen(const char* label) {
    LB::clear();
    LB::setCursor(5, 5);
    LB::println(label);
    LB::setCursor(5, 20);
    LB::print("> ");
}

// Draw bottom prompt/status line in chat view (y=120, h=15)
static void llmGWDrawChatPrompt(const char* text, uint16_t color) {
    LB::fillRect(0, 120, 240, 15, TFT_BLACK);
    LB::setCursor(2, 122);
    LB::setTextColor(color);
    LB::print(text);
    LB::setTextColor(TFT_WHITE);
}

static void llmGWDrawStatus(const char* line1, const char* line2) {
    LB::clear();
    LB::setTextSize(1);
    LB::setCursor(5, 50);
    LB::println(line1);
    if (line2) {
        LB::setCursor(5, 65);
        LB::println(line2);
    }
}

static void llmGWShowError(LLMGWError err) {
    LB::clear();
    LB::setTextSize(1);
    LB::setCursor(5, 50);
    LB::setTextColor(TFT_RED);
    LB::print("Error: ");
    LB::println(llmGWErrorToString(err));
    LB::setTextColor(TFT_WHITE);
    LB::setCursor(5, 75);
    LB::println("Press any key...");

    while (true) {
        M5.update();
        M5Cardputer.update();
        if (M5Cardputer.Keyboard.isPressed()) break;
        delay(50);
    }
    delay(200);
}

static int llmGWSelectModel() {
    if (llmGWSession.models.empty()) {
        return -1;
    }

    int selected = 0;
    int offset = 0;
    const int maxVisible = 8;

    while (true) {
        LB::clear();
        LB::setTextSize(1);
        LB::setCursor(5, 5);
        LB::setTextColor(TFT_CYAN);
        LB::println("Select Model (;/. to scroll)");
        LB::setTextColor(TFT_WHITE);

        for (int i = 0; i < maxVisible && (offset + i) < llmGWSession.models.size(); i++) {
            int idx = offset + i;
            LB::setCursor(5, 20 + i * 13);

            LB::setTextColor(idx == selected ? TFT_GREEN : TFT_WHITE);
            LB::print(idx == selected ? "> " : "  ");

            String modelName = llmGWSession.models[idx];
            if (modelName.length() > 32) {
                modelName = modelName.substring(0, 29) + "...";
            }
            LB::println(modelName);
        }

        LB::setTextColor(TFT_DARKGREY);
        LB::setCursor(5, 125);
        LB::printf("%d/%d  [Enter]=Select [Esc]=Back",
                          selected + 1, llmGWSession.models.size());
        LB::setTextColor(TFT_WHITE);

        // Wait for input
        while (true) {
            M5.update();
            M5Cardputer.update();

            if (M5Cardputer.Keyboard.isKeyPressed(KEY_BACKSPACE)) {
                delay(200);
                return -1;  // Cancel
            }

            if (M5Cardputer.Keyboard.isKeyPressed(KEY_ENTER)) {
                delay(200);
                return selected;
            }

            if (M5Cardputer.Keyboard.isKeyPressed(';')) {
                if (selected > 0) {
                    selected--;
                    if (selected < offset) offset = selected;
                }
                delay(150);
                break;
            }

            if (M5Cardputer.Keyboard.isKeyPressed('.')) {
                if (selected < llmGWSession.models.size() - 1) {
                    selected++;
                    if (selected >= offset + maxVisible) offset = selected - maxVisible + 1;
                }
                delay(150);
                break;
            }

            delay(30);
        }
    }
}

// ============================================================================
// Word wrapping utility
// ============================================================================

static void wrapText(const String& text, std::vector<String>& lines, int maxChars) {
    String currentLine = "";
    String word = "";

    for (int i = 0; i <= text.length(); i++) {
        char c = (i < text.length()) ? text[i] : ' ';

        if (c == ' ' || c == '\n' || i == text.length()) {
            if (word.length() > 0) {
                if (currentLine.length() + word.length() + 1 > maxChars) {
                    if (currentLine.length() > 0) {
                        lines.push_back(currentLine);
                        currentLine = "";
                    }
                }

                if (currentLine.length() > 0) currentLine += " ";
                currentLine += word;
                word = "";
            }

            if (c == '\n') {
                lines.push_back(currentLine);
                currentLine = "";
            }
        } else {
            word += c;
        }
    }

    if (currentLine.length() > 0) {
        lines.push_back(currentLine);
    }
}

// ============================================================================
// Chat Loop
// ============================================================================

static void llmGWChatLoop() {
    std::vector<String> chatLines;
    int scrollOffset = 0;
    bool needRedraw = true;

    chatLines.push_back("=== LLM Gateway Chat ===");
    chatLines.push_back("Model: " + String(llmGWSession.currentModel));
    chatLines.push_back("");
    chatLines.push_back("Type message, Enter to send");
    chatLines.push_back("Backspace to exit");
    chatLines.push_back("------------------------");

    while (true) {
        // Draw chat history
        if (needRedraw) {
            LB::clear();

            int startLine = max(0, (int)chatLines.size() - LLM_GW_LINES_PER_PAGE + scrollOffset);
            for (int i = 0; i < LLM_GW_LINES_PER_PAGE && (startLine + i) < chatLines.size(); i++) {
                LB::setCursor(2, 2 + i * LLM_GW_LINE_HEIGHT);
                String line = chatLines[startLine + i];
                if (line.length() > LLM_GW_CHARS_PER_LINE) {
                    line = line.substring(0, LLM_GW_CHARS_PER_LINE);
                }
                LB::print(line);
            }
            needRedraw = false;
        }

        // Show prompt
        llmGWDrawChatPrompt("> ", TFT_GREEN);

        // Handle keyboard input first
        M5.update();
        M5Cardputer.update();

        if (M5Cardputer.Keyboard.isKeyPressed(KEY_BACKSPACE)) {
            delay(200);
            break;
        }

        if (M5Cardputer.Keyboard.isKeyPressed(';') && scrollOffset < 0) {
            scrollOffset++;
            needRedraw = true;
            delay(150);
            continue;
        } else if (M5Cardputer.Keyboard.isKeyPressed('.') && scrollOffset > -(int)chatLines.size() + LLM_GW_LINES_PER_PAGE) {
            scrollOffset--;
            needRedraw = true;
            delay(150);
            continue;
        }

        // Get user input
        String userInput = getUserInput(false);

        if (userInput.length() == 0) {
            delay(100);
            continue;
        }

        // Add user message to display
        chatLines.push_back("");
        std::vector<String> userLines;
        wrapText("You: " + userInput, userLines, LLM_GW_CHARS_PER_LINE);
        for (const String& line : userLines) {
            chatLines.push_back(line);
        }
        scrollOffset = 0;
        needRedraw = true;

        // Draw status
        llmGWDrawChatPrompt("Thinking...", TFT_YELLOW);

        // Send message
        String response;
        LLMGWError err = llmGWSendMessage(userInput.c_str(), response);

        if (err != LLM_GW_OK) {
            if (err == LLM_GW_ERR_SESSION_EXPIRED && llmGWConfig.autoReconnect) {
                // Try to re-authenticate
                err = llmGWAuthenticate();
                if (err == LLM_GW_OK) {
                    err = llmGWStartChat(llmGWSession.currentModel);
                    if (err == LLM_GW_OK) {
                        err = llmGWSendMessage(userInput.c_str(), response);
                    }
                }
            }

            if (err != LLM_GW_OK) {
                chatLines.push_back("");
                chatLines.push_back("Error: " + String(llmGWErrorToString(err)));
                needRedraw = true;
                continue;
            }
        }

        // Add assistant response
        chatLines.push_back("");
        std::vector<String> responseLines;
        wrapText("AI: " + response, responseLines, LLM_GW_CHARS_PER_LINE);
        for (const String& line : responseLines) {
            chatLines.push_back(line);
        }
        needRedraw = true;
    }

    llmGWStopChat();
}

// ============================================================================
// Disconnect
// ============================================================================

static void llmGWDisconnect() {
    llmGWStopChat();
    llmGWSession.sessionToken[0] = '\0';
    llmGWSession.tokenExpiresAt = 0;
    llmGWSession.state = LLM_GW_STATE_DISCONNECTED;
    llmGWSession.client.stop();
}

// ============================================================================
// Error/State strings
// ============================================================================

const char* llmGWErrorToString(LLMGWError err) {
    switch (err) {
        case LLM_GW_OK:                     return "OK";
        case LLM_GW_ERR_NO_WIFI:            return "No WiFi";
        case LLM_GW_ERR_NO_SERVER:          return "Server not found";
        case LLM_GW_ERR_CONNECT_FAILED:     return "Connection failed";
        case LLM_GW_ERR_HTTP_ERROR:         return "HTTP error";
        case LLM_GW_ERR_AUTH_FAILED:        return "Auth failed";
        case LLM_GW_ERR_SIGNATURE_FAILED:   return "Signature failed";
        case LLM_GW_ERR_SESSION_EXPIRED:    return "Session expired";
        case LLM_GW_ERR_CHAT_FAILED:        return "Chat failed";
        case LLM_GW_ERR_TIMEOUT:            return "Timeout";
        case LLM_GW_ERR_PARSE_ERROR:        return "Parse error";
        case LLM_GW_ERR_NO_KEYS:            return "Keys not found";
        case LLM_GW_ERR_USER_CANCEL:        return "Cancelled";
        case LLM_GW_ERR_OLLAMA_UNAVAILABLE: return "Ollama unavailable";
        case LLM_GW_ERR_MODEL_NOT_FOUND:    return "Model not found";
        default:                            return "Unknown error";
    }
}

const char* llmGWStateToString(LLMGWState state) {
    switch (state) {
        case LLM_GW_STATE_DISCONNECTED:     return "Disconnected";
        case LLM_GW_STATE_CONNECTING:       return "Connecting";
        case LLM_GW_STATE_AUTHENTICATING:   return "Authenticating";
        case LLM_GW_STATE_READY:            return "Ready";
        case LLM_GW_STATE_CHATTING:         return "Chatting";
        case LLM_GW_STATE_ERROR:            return "Error";
        default:                            return "Unknown";
    }
}

// ============================================================================
// Main Entry Point
// ============================================================================

void llmGatewayChat() {
    // Check WiFi
    if (WiFi.status() != WL_CONNECTED) {
        waitAndReturnToMenu("Not connected to WiFi");
        return;
    }

    inMenu = false;

    // Load config
    llmGWLoadConfig();

    // Initialize RNG
    mbedtls_entropy_init(&llmGWSession.entropy);
    mbedtls_ctr_drbg_init(&llmGWSession.ctr_drbg);
    const char* pers = "llmgw_session";
    mbedtls_ctr_drbg_seed(&llmGWSession.ctr_drbg, mbedtls_entropy_func,
                          &llmGWSession.entropy, (const uint8_t*)pers, strlen(pers));

    // Check if RDP keys exist (LLM Gateway uses same keys as Remote Desktop)
    if (!llmGWKeysExist()) {
        llmGWDrawStatus("No RDP keys found!", "Use Remote Desktop first");
        delay(2000);
        waitAndReturnToMenu("Generate keys via RDP");
        return;
    }

    // Load keys
    if (!llmGWLoadKeys()) {
        waitAndReturnToMenu("Failed to load keys");
        return;
    }

    // Get server address if not configured
    if (strlen(llmGWConfig.serverHost) == 0) {
        llmGWPromptScreen("Enter Gateway IP:");
        String host = getUserInput(false);
        if (host.length() == 0) {
            waitAndReturnToMenu("Cancelled");
            return;
        }
        strlcpy(llmGWConfig.serverHost, host.c_str(), sizeof(llmGWConfig.serverHost));
        llmGWSaveConfig();
    }

    // Authenticate
    llmGWDrawStatus("Connecting to", llmGWConfig.serverHost);
    LLMGWError err = llmGWAuthenticate();
    if (err != LLM_GW_OK) {
        llmGWShowError(err);
        llmGWDisconnect();
        inMenu = true;
        return;
    }

    // Fetch models
    err = llmGWFetchModels();
    if (err != LLM_GW_OK) {
        llmGWShowError(err);
        llmGWDisconnect();
        inMenu = true;
        return;
    }

    if (llmGWSession.models.empty()) {
        waitAndReturnToMenu("No models available");
        llmGWDisconnect();
        return;
    }

    // Select model
    int modelIdx = llmGWSelectModel();
    if (modelIdx < 0) {
        llmGWDisconnect();
        inMenu = true;
        return;
    }

    const char* selectedModel = llmGWSession.models[modelIdx].c_str();

    // Start chat session
    err = llmGWStartChat(selectedModel);
    if (err != LLM_GW_OK) {
        llmGWShowError(err);
        llmGWDisconnect();
        inMenu = true;
        return;
    }

    // Run chat loop
    llmGWChatLoop();

    // Cleanup
    llmGWDisconnect();
    mbedtls_entropy_free(&llmGWSession.entropy);
    mbedtls_ctr_drbg_free(&llmGWSession.ctr_drbg);

    inMenu = true;
}
